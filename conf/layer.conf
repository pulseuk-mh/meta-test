## conf/layer.conf
```bitbake
# We have a conf and classes directory, add to BBPATH
BBPATH .= ":${LAYERDIR}"

# We have recipes-* directories, add to BBFILES
BBFILES += "${LAYERDIR}/recipes-*/*/*.bb \
	${LAYERDIR}/recipes-*/*/*.bbappend"

BBFILE_COLLECTIONS += "pulse"
BBFILE_PATTERN_pulse = "^${LAYERDIR}/"
BBFILE_PRIORITY_pulse = "6"

#LAYERDEPENDS_pulse = "core"

# 
LAYERRECOMMENDS_pulse = ""

# meta-filesystems is needed to build cascync with fuse support (the default)
#LAYERRECOMMENDS_pulse += "meta-filesystems"
#LAYERRECOMMENDS_pulse += ""

LAYERSERIES_COMPAT_pulse = "kirkstone"

# Sanity check for meta layer.
#INHERIT += ""
```
